## firmware/components/fleet/Kconfig.projbuild
```kconfig
menu "UPS to ESP32 Module fleet heartbeat"

config UPSA_FLEET_URL
    string "Fleet heartbeat endpoint (Supabase project URL)"
    default ""
    help
        The Supabase project URL, e.g. https://abcd.supabase.co. The board
        calls its heartbeat() function there. Empty: the heartbeat is built
        in but never sends, and the page says it is not configured.

config UPSA_FLEET_KEY
    string "Fleet heartbeat public key"
    default ""
    help
        The project's PUBLIC (anon / publishable) key. It ships in open-source
        firmware, so it must only be able to call heartbeat(): see
        telemetry/supabase.sql. Never the service_role key.

endmenu
```

## firmware/components/history/Kconfig.projbuild
```kconfig
config UPSA_HISTORY
    bool "Long history (a reading every 10 s, about 28 days, kept on flash)"
    depends on UPSA_OUTAGE_LOG
    default y
    help
        Keeps a reading of the UPS every ten seconds in the outagelog
        partition beyond the outage records, about 28 days of them, across
        restarts and updates, for the web page's chart (1 hour to 30 days).
        Rev B only. See components/history.
```

## firmware/components/outagelog/Kconfig.projbuild
```kconfig
config UPSA_OUTAGE_LOG
    bool "Outage log (every transfer to battery, kept on flash)"
    depends on UPSA_BOARD_REV_B
    default y
    help
        Records every transfer to battery on the outagelog partition: when it
        began and ended, the charge and the UPS's runtime estimate along the
        way, and why it ended. Kept across restarts and updates, shown on the
        web page. Rev B only: it needs the 16 MB part's spare flash, which the
        Rev A N4 does not have. Also sets the board's clock over SNTP
        (pool.ntp.org) for the records' times. See components/outagelog.
```

## firmware/components/tailnet/Kconfig.projbuild
```kconfig
menu "My UPS Pal Tailscale"

config UPSA_TAILSCALE
    bool "Tailscale on the board"
    depends on UPSA_BOARD_REV_B && SPIRAM
    default n
    help
        Joins this board to a tailnet with MicroLink (components/microlink),
        so NUT on 3493 and the web UI are reachable from anywhere on the
        tailnet without a subnet router. Rev B only: MicroLink keeps half a
        megabyte or more of control-plane state in PSRAM, which the N4 does
        not have.

        This only builds the client in. Whether it runs, and with which auth
        key, is set on the board from the web UI and kept in NVS -- never in
        the image, which is published for every board to download.

        Build it with sdkconfig.defaults.tailscale layered after
        sdkconfig.defaults.revb; that file sets the mbedTLS and lwIP options
        MicroLink needs. See components/tailnet/README.md.

endmenu
```
